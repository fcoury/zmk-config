## Kconfig
```kconfig
menuconfig KNUCKLES_TPS43_IDLE_POLLING
    bool "Diagnostic TPS43 polling that follows ZMK activity"
    depends on SHIELD_KNUCKLES_TPS43_RIGHT
    depends on INPUT_AZOTEQ_IQS5XX
    default n
    help
      Keep normal polling while active and reduce I2C polling while idle.
      This does not configure the sensor's own power modes.

if KNUCKLES_TPS43_IDLE_POLLING

config KNUCKLES_TPS43_IDLE_POLL_INTERVAL_MS
    int "TPS43 polling interval while ZMK is idle (milliseconds)"
    range 20 1000
    default 250

endif
```

## config/boards/shields/holykeebs_tps43/Kconfig.shield
```kconfig
# Copyright (c) 2025
# SPDX-License-Identifier: MIT

config SHIELD_HOLYKEEBS_TPS43
	def_bool $(shields_list_contains,holykeebs_tps43)
```

## dts/bindings/behaviors/knuckles,behavior-bt-toggle.yaml
```yaml
description: Toggle between the first two Bluetooth host profiles
compatible: "knuckles,behavior-bt-toggle"
include: zero_param.yaml
```
