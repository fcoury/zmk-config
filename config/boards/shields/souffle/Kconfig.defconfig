## config/boards/shields/souffle/Kconfig.defconfig
```kconfig
if SHIELD_SOUFFLE_LEFT

config ZMK_KEYBOARD_NAME
    default "Souffle"

config ZMK_SPLIT_ROLE_CENTRAL
    default y

endif

if SHIELD_SOUFFLE_LEFT || SHIELD_SOUFFLE_RIGHT

config ZMK_SPLIT
    default y

endif
```

## config/boards/shields/souffle/Kconfig.shield
```kconfig
config SHIELD_SOUFFLE_LEFT
    def_bool $(shields_list_contains,souffle_left)

config SHIELD_SOUFFLE_RIGHT
    def_bool $(shields_list_contains,souffle_right)
```

## config/boards/shields/zeph/Kconfig.defconfig
```kconfig
if SHIELD_ZEPH_LEFT

config ZMK_KEYBOARD_NAME
    default "Zeph"

config ZMK_SPLIT_ROLE_CENTRAL
    default y

endif

if SHIELD_ZEPH_LEFT || SHIELD_ZEPH_RIGHT

config ZMK_SPLIT
    default y

endif
```

## config/boards/shields/zeph/Kconfig.shield
```kconfig
config SHIELD_ZEPH_LEFT
    def_bool $(shields_list_contains,zeph_left)

config SHIELD_ZEPH_RIGHT
    def_bool $(shields_list_contains,zeph_right)
```
