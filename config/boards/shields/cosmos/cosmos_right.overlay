#include "cosmos.dtsi"

&default_transform {
    col-offset = <3>;
};

&kscan0 {
    col-gpios
        = <&gpio0 17 GPIO_ACTIVE_HIGH> // Col  3 P0.17
        , <&gpio0 20 GPIO_ACTIVE_HIGH> // Col  4 P0.20
        , <&gpio0 22 GPIO_ACTIVE_HIGH> // Col  5 P0.22
        , <&gpio0 24 GPIO_ACTIVE_HIGH> // Col  6 P0.24
        , <&gpio1 0  GPIO_ACTIVE_HIGH> // Col  7 P1.00
        , <&gpio0 11 GPIO_ACTIVE_HIGH> // Col  8 P0.11
        , <&gpio1 40 GPIO_ACTIVE_HIGH> // Col  9 P1.04
        , <&gpio1 6  GPIO_ACTIVE_HIGH> // Col 10 P1.06
        , <&gpio0 31 GPIO_ACTIVE_HIGH> // Col 11 P0.31
        ;
};
