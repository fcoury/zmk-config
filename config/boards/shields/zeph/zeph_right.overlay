#include "zeph.dtsi"

&default_transform { 
    col-offset = <6>;
};

&kscan0 {
    col-gpios
        = <&gpio1 13 GPIO_ACTIVE_HIGH> // Col 5
        , <&gpio1 15 GPIO_ACTIVE_HIGH> // Col 4
        , <&gpio0 2  GPIO_ACTIVE_HIGH> // Col 3
        , <&gpio0 22 GPIO_ACTIVE_HIGH> // Col 2
        , <&gpio0 29 GPIO_ACTIVE_HIGH> // Col 1
        , <&gpio0 31 GPIO_ACTIVE_HIGH> // Col 0
        ;
};
